## boards/arm/eyelash_sofle/board.yml
```yaml
board:
  name: eyelash_sofle
  vendor: eyelashperipherals
  socs:
    - name: nrf52840
```

## boards/nordic_nrf/eyelash_sofle/Kconfig.board
```kconfig
#
# Copyright (c) 2024 The ZMK Contributors
# SPDX-License-Identifier: MIT
#

config BOARD_EYELASH_SOFLE
    bool
    select SOC_NRF52840_QIAA

config BOARD_EYELASH_SOFLE_LEFT
    bool
    select BOARD_EYELASH_SOFLE

config BOARD_EYELASH_SOFLE_RIGHT
    bool
    select BOARD_EYELASH_SOFLE
```

## boards/nordic_nrf/eyelash_sofle/board.yml
```yaml
board:
  name: eyelash_sofle
  full_name: Eyelash Sofle
  vendor: eyelashperipherals
  socs:
    - name: nrf52840
      variants:
        - name: left
        - name: right
```
